## arch/arm/mach-owl/Kconfig
```kconfig
if ARCH_OWL

choice
	prompt "Actions OWL SoC select"
	optional

config S900
	bool "S900 family"
	select ARM64

config S700
	bool "S700 family"
	select ARM64

config ATS3605
	bool "ATS3605 family"
	select CPU_V7
endchoice

config SYS_SOC
	default "owl"

config SYS_MALLOC_F_LEN
	default 0x800

source "arch/arm/mach-owl/s900/Kconfig"
source "arch/arm/mach-owl/s700/Kconfig"
source "arch/arm/mach-owl/ats3605/Kconfig"

endif
```

## arch/arm/mach-owl/ats3605/Kconfig
```kconfig
if ATS3605

choice
	prompt "ATS3605 board select"
	optional

config TARGET_ATS3605_UPGRADE
	bool "Actions ATS3605 upgrade"
	help
	  Directly jump kernel/initramfs that already download to ddr by
	  production tool. Only used for burn firmware.

config TARGET_LS370A_EVB
	bool "Actions LS370A_evb slc nandflash board"

config TARGET_ATS3605_EVB_MLC
	bool "Actions ats3605_evb mlc nandflash board"

config TARGET_LS360F_EVB
	bool "Actions ls360f_evb board spi norflash"

config TARGET_HOBOT_EVB
	bool "Actions hotbot_evb slc nandflash board"

config TARGET_LS360F_EVB_LCD
	bool "Actions ls360f_evb lcd  board spi norflash"

config TARGET_LS360F_EVB_MULTIMIC
	bool "Actions ls360f_evb_multimic board spi norflash"

config TARGET_LS360F_EVB_WIBOX
	bool "Actions ls360f_evb_wibox board spi norflash"	
config TARGET_LS360F_NAND_ZXF86
	bool "Actions ls360f_nand_zxf86 board nandflash"
	
config TARGET_LS360F_NAND_GJLX
	bool "Actions ls360f_nand_gjlx board nandflash"
endchoice

source "board/actions/ats3605_upgrade/Kconfig"
source "board/actions/ls370a_evb/Kconfig"
source "board/actions/ats3605_evb_mlc/Kconfig"
source "board/actions/ls360f_evb/Kconfig"
source "board/actions/hobot_evb/Kconfig"
source "board/actions/ls360f_evb_lcd/Kconfig"
source "board/actions/ls360f_evb_multimic/Kconfig"
source "board/actions/ls360f_evb_wibox/Kconfig"
source "board/actions/ls360f_nand_zxf86/Kconfig"
source "board/actions/ls360f_nand_gjlx/Kconfig"
endif
```

## board/actions/ats3605_evb_mlc/Kconfig
```kconfig
if TARGET_ATS3605_EVB_MLC

config SYS_BOARD
	default "ats3605_evb_mlc"

config SYS_VENDOR
	default "actions"

config SYS_CONFIG_NAME
	default "ats3605_evb_mlc"

endif
```

## board/actions/ats3605_upgrade/Kconfig
```kconfig
if TARGET_ATS3605_UPGRADE

config SYS_BOARD
	default "ats3605_upgrade"

config SYS_VENDOR
	default "actions"

config SYS_CONFIG_NAME
	default "ats3605_upgrade"

endif
```

## board/actions/hobot_evb/Kconfig
```kconfig
if TARGET_HOBOT_EVB

config SYS_BOARD
	default "hobot_evb"

config SYS_VENDOR
	default "actions"

config SYS_CONFIG_NAME
	default "hobot_evb"

endif
```

## board/actions/ls360f_evb/Kconfig
```kconfig
if TARGET_LS360F_EVB

config SYS_BOARD
	default "ls360f_evb"

config SYS_VENDOR
	default "actions"

config SYS_CONFIG_NAME
	default "ls360f_evb"

endif
```

## board/actions/ls360f_evb_lcd/Kconfig
```kconfig
if TARGET_LS360F_EVB_LCD

config SYS_BOARD
	default "ls360f_evb_lcd"

config SYS_VENDOR
	default "actions"

config SYS_CONFIG_NAME
	default "ls360f_evb_lcd"

endif
```

## board/actions/ls360f_evb_multimic/Kconfig
```kconfig
if TARGET_LS360F_EVB_MULTIMIC

config SYS_BOARD
	default "ls360f_evb_multimic"

config SYS_VENDOR
	default "actions"

config SYS_CONFIG_NAME
	default "ls360f_evb_multimic"

endif
```

## board/actions/ls360f_evb_wibox/Kconfig
```kconfig
if TARGET_LS360F_EVB_WIBOX

config SYS_BOARD
	default "ls360f_evb_wibox"

config SYS_VENDOR
	default "actions"

config SYS_CONFIG_NAME
	default "ls360f_evb_wibox"

endif
```

## board/actions/ls360f_nand_gjlx/Kconfig
```kconfig
if TARGET_LS360F_NAND_GJLX

config SYS_BOARD
	default "ls360f_nand_gjlx"

config SYS_VENDOR
	default "actions"

config SYS_CONFIG_NAME
	default "ls360f_nand_gjlx"

endif
```

## board/actions/ls360f_nand_zxf86/Kconfig
```kconfig
if TARGET_LS360F_NAND_ZXF86

config SYS_BOARD
	default "ls360f_nand_zxf86"

config SYS_VENDOR
	default "actions"

config SYS_CONFIG_NAME
	default "ls360f_nand_zxf86"

endif
```

## board/actions/ls370a_evb/Kconfig
```kconfig
if TARGET_LS370A_EVB

config SYS_BOARD
	default "ls370a_evb"

config SYS_VENDOR
	default "actions"

config SYS_CONFIG_NAME
	default "ls370a_evb"

endif
```

## drivers/usb/aotg/Kconfig
```kconfig
#
# Actions USB Controller Drivers
#

config USB_AOTG_HCD
	bool "Aotg HCD (USB 2.0) support"
	default n
	help
	  The AOTG Host Controller is compatible with USB 2.0 which supports
	  low-speed, full-speed and high-spped devices.
	  For now, we only support Control and Bulk transfers, and we use
	  cpu mode cause we don't care about performance much.

if USB_AOTG_HCD

config AOTG_NEW_MODE
	bool "Aotg HCD supports Transfer Ring"
	default n
	help
	  Enable this for New design for Aotg HCD which uses TRB(DMA)
	  scheme instead of cpu. The sad fact is that some AOTG
	  controller doesn't support cpu mode for BULK transfer, so
	  we have to use DMA.

endif
```
